## arch/arm/mach-mediatek/Kconfig
```kconfig
menuconfig ARCH_MEDIATEK
	bool "Mediatek MT65xx & MT81xx SoC"
	depends on ARCH_MULTI_V7
	select ARM_GIC
	select PINCTRL
	select MTK_TIMER
	select MFD_SYSCON
	help
	  Support for Mediatek MT65xx & MT81xx SoCs

if ARCH_MEDIATEK

config MACH_MT2701
	bool "MediaTek MT2701 SoCs support"
	default ARCH_MEDIATEK

config MACH_MT6589
	bool "MediaTek MT6589 SoCs support"
	default ARCH_MEDIATEK

config MACH_MT6592
	bool "MediaTek MT6592 SoCs support"
	default ARCH_MEDIATEK

config MACH_MT7623
	bool "MediaTek MT7623 SoCs support"
	default ARCH_MEDIATEK

config MACH_MT8127
	bool "MediaTek MT8127 SoCs support"
	default ARCH_MEDIATEK

config MACH_MT8135
	bool "MediaTek MT8135 SoCs support"
	default ARCH_MEDIATEK

config MACH_MT8163
	bool "MediaTek MT8163"
	select HAVE_ARM_ARCH_TIMER
	select MTK_BASE_POWER
	select MTK_SYS_CIRQ
	select MTK_GIC_EXT
	select CPU_IDLE
	select CPU_IDLE_GOV_MTK
	select MTK_SCHED_RQAVG_KS
	select MTK_SCHED_RQAVG_US

endif
```

## drivers/staging/amazon/Kconfig
```kconfig
menu "Amazon"

config ROOK
	bool "Rook MTK platform project"
	help
	isolate amazon Rook changes for MTK Platform

config CHECKERS
	bool "Checkers MTK platform project"
	help
	isolate amazon Checkers changes for MTK Platform

config DOUGLAS
	bool "Douglas MTK platform project"
	help
	isolate amazon Douglas changes for MTK Platform

config GIZA
	bool "Giza MTK platform project"
	help
	isolate amazon Giza changes for MTK Platform

config CROWN
	bool "Crown MTK platform project"
	help
	isolate amazon Crown changes for MTK Platform

config CRONOS
	bool "Cronos MTK platform project"
	help
	isolate amazon Cronos changes for MTK Platform

config BISCUIT
	bool "Biscuit MTK platform project"
	help
	isolate amazon Biscuit changes for MTK Platform

config BISCUIT_SAFE_BOOTARGS
	bool "Keep only safe Biscuit bootloader arguments"
	depends on BISCUIT && CMDLINE_FORCE && OF_EARLY_FLATTREE
	help
	  With CONFIG_CMDLINE_FORCE, append only androidboot.serialno=,
	  androidboot.bootreason= and boot_reason= from the Fire OS LK
	  bootargs, dropping its root=, dm= and stale slot arguments.

endmenu
```
